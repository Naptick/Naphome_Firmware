## samples/atom_echo_rules_demo/sdkconfig.defaults
```kconfig
CONFIG_PARTITION_TABLE_CUSTOM=y
CONFIG_PARTITION_TABLE_CUSTOM_FILENAME="partitions.csv"
CONFIG_PARTITION_TABLE_FILENAME="partitions.csv"
CONFIG_SPI_FLASH_DANGEROUS_WRITE_ABORTS=y
CONFIG_ESPTOOLPY_FLASHMODE_DIO=y
CONFIG_ESPTOOLPY_FLASHFREQ_80M=y
CONFIG_ESPTOOLPY_FLASHSIZE_8MB=y
CONFIG_BT_ENABLED=y
CONFIG_BT_CONTROLLER_ENABLED=y
CONFIG_BTDM_CTRL_MODE_BLE_ONLY=y
CONFIG_BT_BLE_ENABLED=y
CONFIG_BT_NIMBLE_ENABLED=y
CONFIG_NAPHOME_WIFI_SSID="The Chateau"
CONFIG_NAPHOME_WIFI_PASSWORD="thechateau"
CONFIG_COMPILER_CXX_EXCEPTIONS=y
CONFIG_COMPILER_CXX_RTTI=y
```

## samples/korvo_farfield_mic_demo/main/Kconfig.projbuild
```kconfig
menu "Korvo Far-Field Mic Demo"

    config KORVO_FARFIELD_LED_GPIO
        int "WS2812 LED GPIO pin"
        default 19
        help
            GPIO pin connected to WS2812 LED strip data line.
            Default is GPIO19 for Korvo-1. Note: ES7210 I2C SDA uses GPIO1.

    config KORVO_FARFIELD_LED_COUNT
        int "Number of LEDs in strip"
        default 12
        help
            Number of WS2812 LEDs in the strip.
            Default is 12 for Korvo-1 ring.

    config KORVO_FARFIELD_LED_BRIGHTNESS
        int "LED brightness (0-255)"
        range 0 255
        default 32
        help
            Brightness level for LEDs (0-255).
            Lower values reduce power consumption.

    config KORVO_FARFIELD_SAMPLE_RATE
        int "Audio sample rate (Hz)"
        default 16000
        help
            I2S sample rate for microphone capture.
            16000 Hz is standard for voice applications.

    config KORVO_FARFIELD_FRAME_SIZE_MS
        int "Audio frame size (milliseconds)"
        default 20
        range 10 100
        help
            Size of each audio frame in milliseconds.
            Smaller values = more responsive LEDs but more CPU usage.

    config KORVO_FARFIELD_WAKE_WORD_ENABLE
        bool "Enable wake word detection (ESP-SR WakeNet)"
        default y
        help
            Enable wake word detection using ESP-SR WakeNet.
            When enabled, the device will listen for the configured wake word.

    config KORVO_FARFIELD_WAKE_WORD_MODEL
        string "Wake word model name"
        default "wn9_hiesp"
        depends on KORVO_FARFIELD_WAKE_WORD_ENABLE
        help
            WakeNet model to use. Available models: wn9_hiesp, wn9_hilexin, wn9_alexa, etc.
            For custom wake word "Naptick", you need to train a custom model via Espressif's customization process.

    config KORVO_FARFIELD_WAKE_WORD_THRESHOLD
        int "Wake word detection threshold (0-100)"
        default 60
        range 0 100
        depends on KORVO_FARFIELD_WAKE_WORD_ENABLE
        help
            Detection threshold (higher = less sensitive, fewer false positives).

endmenu
```

## samples/korvo_farfield_mic_demo/sdkconfig.defaults
```kconfig
# Korvo-1 Far-Field Microphone Array Demo Default Configuration

# Target chip
CONFIG_IDF_TARGET="esp32s3"

# LED Strip Configuration
CONFIG_KORVO_FARFIELD_LED_GPIO=19
CONFIG_KORVO_FARFIELD_LED_COUNT=12
CONFIG_KORVO_FARFIELD_LED_BRIGHTNESS=32

# Audio Configuration
CONFIG_KORVO_FARFIELD_SAMPLE_RATE=16000
CONFIG_KORVO_FARFIELD_FRAME_SIZE_MS=20

# FreeRTOS
CONFIG_FREERTOS_HZ=1000

# Logging
CONFIG_LOG_DEFAULT_LEVEL_INFO=y
CONFIG_LOG_MAXIMUM_LEVEL_VERBOSE=y

# Partition Table - Custom with model partition for esp-sr
CONFIG_PARTITION_TABLE_CUSTOM=y
CONFIG_PARTITION_TABLE_CUSTOM_FILENAME="partitions.csv"

# ESP-SR WakeNet Model Selection - "hi esp" wake word
CONFIG_SR_WN_WN9_HIESP=y

# Enable wake word detection
CONFIG_KORVO_FARFIELD_WAKE_WORD_ENABLE=y
CONFIG_KORVO_FARFIELD_WAKE_WORD_MODEL="wn9_hiesp"
CONFIG_KORVO_FARFIELD_WAKE_WORD_THRESHOLD=60

# Flash size - Korvo-1 has 8MB flash
CONFIG_ESPTOOLPY_FLASHSIZE_8MB=y
```

## samples/korvo_led_demo/main/Kconfig.projbuild
```kconfig
menu "Korvo LED Demo"

config LED_DEMO_STRIP_GPIO
    int "WS2812 data GPIO"
    default 19
    help
        GPIO that feeds the built-in Korvo WS2812 ring. GPIO19 is routed to the
        factory LED chain on Korvo-1 production boards.

config LED_DEMO_LED_COUNT
    int "Number of pixels"
    default 12
    range 1 64
    help
        Total number of addressable LEDs on the Korvo-1 ring.

config LED_DEMO_BRIGHTNESS
    int "Brightness (0-255)"
    default 32
    range 1 255
    help
        Global brightness scalar applied to every RGB value before writing it to the strip.

config LED_DEMO_PATTERN_INTERVAL_MS
    int "Pattern duration (ms)"
    default 1500
    range 250 10000
    help
        Number of milliseconds to display each status pattern before advancing to the
        next example.

config LED_DEMO_SPIN_DELAY_MS
    int "Chase frame delay (ms)"
    default 40
    range 10 500
    help
        Delay inserted between frames of the rainbow chase animation across the
        remaining LEDs.

endmenu
```

## samples/korvo_led_demo/sdkconfig.defaults
```kconfig
CONFIG_LED_DEMO_STRIP_GPIO=19
CONFIG_LED_DEMO_LED_COUNT=12
CONFIG_LED_DEMO_BRIGHTNESS=32
CONFIG_LED_DEMO_PATTERN_INTERVAL_MS=1500
CONFIG_LED_DEMO_SPIN_DELAY_MS=40
```

## samples/korvo_openai_voice/Kconfig.projbuild
```kconfig
menu "Korvo OpenAI Voice Demo"

config KORVO_OPENAI_WIFI_SSID
    string "Wi-Fi SSID"
    help
        Station SSID used by the demo to connect before calling OpenAI.

config KORVO_OPENAI_WIFI_PASSWORD
    string "Wi-Fi Password"
    default ""
    help
        Station password. Leave empty for open networks.

config KORVO_OPENAI_SAMPLE_RATE
    int "Microphone sample rate (Hz)"
    default 16000
    range 8000 48000

config KORVO_OPENAI_CAPTURE_MS
    int "Capture duration (ms)"
    default 2000
    range 200 10000

config KORVO_OPENAI_TTS_VOICE
    string "OpenAI TTS voice"
    default "alloy"
    help
        Voice name passed to the /v1/audio/speech endpoint.

endmenu
```

## samples/korvo_openwakeword_demo/main/Kconfig.projbuild
```kconfig
menu "OpenWakeWord Demo Configuration"

    config OPENWAKEWORD_DEMO_ENABLE
        bool "Enable OpenWakeWord demo"
        default y
        help
            Enable the OpenWakeWord demonstration application.

endmenu
```

## samples/korvo_openwakeword_demo/sdkconfig.defaults
```kconfig
# Korvo-1 OpenWakeWord Demo Default Configuration

# Target chip
CONFIG_IDF_TARGET="esp32s3"

# OpenWakeWord Configuration
CONFIG_OPENWAKEWORD_ENABLE=y
CONFIG_OPENWAKEWORD_USE_TFLITE=y
CONFIG_OPENWAKEWORD_MODEL_PATH="/spiffs/hey_naptick.tflite"
CONFIG_OPENWAKEWORD_THRESHOLD=0.5
CONFIG_OPENWAKEWORD_FRAME_SIZE_MS=80
CONFIG_OPENWAKEWORD_COOLDOWN_MS=2000
CONFIG_OPENWAKEWORD_TENSOR_ARENA_SIZE=16384
# Enable test mode to test without a model (set to n for production)
CONFIG_OPENWAKEWORD_TEST_MODE=n

# Partition Table - Custom with model partition
CONFIG_PARTITION_TABLE_CUSTOM=y
CONFIG_PARTITION_TABLE_CUSTOM_FILENAME="partitions.csv"

# Flash size
CONFIG_ESPTOOLPY_FLASHSIZE_8MB=y

# Logging
CONFIG_LOG_DEFAULT_LEVEL_INFO=y
CONFIG_LOG_MAXIMUM_LEVEL_VERBOSE=y

# FreeRTOS
CONFIG_FREERTOS_HZ=1000
```

## samples/korvo_voice_assistant/Kconfig.projbuild
```kconfig
menu "Korvo Voice Assistant"

config KVA_WIFI_SSID
    string "Wi-Fi SSID"
    help
        Station SSID used by the assistant before it can reach OpenAI, Spotify, and AWS IoT.

config KVA_WIFI_PASSWORD
    string "Wi-Fi Password"
    default ""
    help
        Station password. Leave empty for open networks.

config KVA_SAMPLE_RATE
    int "Microphone sample rate (Hz)"
    default 16000
    range 8000 48000
    help
        Capture rate passed to the Korvo-1 microphone front-end.

config KVA_CAPTURE_MS
    int "Capture duration (ms)"
    default 2500
    range 500 10000
    help
        Maximum audio length sent to OpenAI after each wake word.

config KVA_WAKE_WORD_SENSITIVITY
    int "Wake-word sensitivity (0-100)"
    default 60
    range 1 100
    help
        Threshold passed to the wake-word detector (higher is less sensitive).

config KVA_SIMULATED_WAKE_INTERVAL_MS
    int "Debug wake trigger interval (ms, 0=disabled)"
    default 0
    range 0 600000
    help
        When non-zero, the wake-word service will simulate a detection on this interval to
        exercise the pipeline without ESP-SR assets.

config KVA_TTS_VOICE
    string "TTS voice"
    default "alloy"
    help
        Voice name for TTS (OpenAI: alloy/nova/shimmer/echo/fable/onyx, Gemini: en-US-Standard-D/en-US-Neural2-D).

config KVA_USE_GEMINI
    bool "Use Gemini AI instead of OpenAI"
    default n
    help
        Enable this to use Google Gemini AI (STT-LLM-TTS) instead of OpenAI.
        Requires GEMINI_API_KEY in ~/.env

config KVA_SPOTIFY_DEVICE_NAME
    string "Spotify Connect device name"
    default "Korvo-1"
    help
        Device identifier to pass to Spotify commands (matches the name shown in the mobile app).

config KVA_SPOTIFY_VOLUME_STEP
    int "Spotify volume step (%)"
    default 10
    range 1 50
    help
        Percentage to nudge volume for volume up/down intents.

config KVA_AWS_TELEMETRY_PERIOD_MS
    int "AWS IoT telemetry period (ms)"
    default 15000
    range 1000 60000
    help
        Interval for publishing assistant state + sensor snapshots to AWS IoT topics.

config KVA_LED_STRIP_GPIO
    int "WS2812 data GPIO"
    default 1
    help
        Set to the GPIO that feeds the Korvo-1 WS2812 chain (GPIO1 by default). Set to -1 to disable LED output.

config KVA_LED_COUNT
    int "WS2812 pixel count"
    default 6
    range 1 64
    help
        Number of LEDs to drive on the WS2812 chain.

config KVA_LED_BRIGHTNESS
    int "LED brightness (0-255)"
    default 32
    range 1 255
    help
        Brightness scaling applied before writing RGB values to the strip.

config KVA_BUTTON1_GPIO
    int "Button 1 GPIO"
    default -1
    help
        Set to the GPIO connected to the Korvo-1 user button. Leave at -1 to disable button support.

config KVA_BUTTON1_ACTIVE_LOW
    bool "Button 1 is active-low"
    default y

config KVA_BUTTON_DEBOUNCE_MS
    int "Button debounce window (ms)"
    default 120
    range 10 1000

config KVA_CODEC_I2C_SDA
    int "ES8388 I2C SDA"
    default 1
    help
        GPIO used for the codec I2C SDA line.

config KVA_CODEC_I2C_SCL
    int "ES8388 I2C SCL"
    default 2
    help
        GPIO used for the codec I2C SCL line.

config KVA_CODEC_I2S_BCLK
    int "ES8388 I2S BCLK"
    default 3
    help
        GPIO used for the codec bit-clock (BCLK).

config KVA_CODEC_I2S_LRCLK
    int "ES8388 I2S LRCLK"
    default 45
    help
        GPIO used for I2S word select / LRCLK.

config KVA_CODEC_I2S_DATA
    int "ES8388 I2S data (DAC)"
    default 46
    help
        GPIO used for I2S data out to the codec (DAC SDIN).

config KVA_CODEC_I2S_MCLK
    int "ES8388 I2S MCLK"
    default 0
    help
        GPIO that provides the master clock to the codec.

config KVA_CODEC_I2S_PORT
    int "I2S port used for codec playback"
    default 1
    range 0 1
    help
        Choose 0 or 1 depending on conflicts with the microphone capture path. Default keeps mic on port 0 and codec playback on port 1.

config KVA_SPOTIFY_USE_CSPOT
    bool "Enable Spotify playback via cspot"
    default y
    help
        Enable this to embed the cspot Spotify Connect receiver. Requires the upstream cspot repository
        to exist alongside Naphome-Firmware (../cspot) and increases flash/RAM usage.

config KVA_SPOTIFY_DEVICE_NAME
    string "Spotify Connect device name"
    default "Korvo Naphome"
    help
        Display name shown in the Spotify app when pairing with this device.

endmenu
```

## samples/korvo_voice_assistant/sdkconfig.defaults
```kconfig
# Naphome Phase 0.9 Firmware Configuration Defaults

# Target chip
CONFIG_IDF_TARGET="esp32s3"

# Component config
CONFIG_ESP_MAIN_TASK_STACK_SIZE=8192
CONFIG_ESP_TASK_WDT_TIMEOUT_S=10

# I2C Configuration
CONFIG_I2C_ENABLE_DEBUG_LOG=n

# WiFi Configuration
CONFIG_ESP32_WIFI_STATIC_RX_BUFFER_NUM=10
CONFIG_ESP32_WIFI_DYNAMIC_RX_BUFFER_NUM=32

# FreeRTOS
CONFIG_FREERTOS_HZ=1000

# Logging
CONFIG_LOG_DEFAULT_LEVEL_INFO=y
CONFIG_LOG_MAX_LEVEL_VERBOSE=y

# Use Gemini AI instead of OpenAI
CONFIG_KVA_USE_GEMINI=y

# Enable Spotify Connect via cspot
CONFIG_KVA_SPOTIFY_USE_CSPOT=y
CONFIG_KVA_SPOTIFY_DEVICE_NAME="Korvo Naphome"

# AWS IoT Configuration
CONFIG_NAPHOME_AWS_IOT_ENDPOINT="a2w3ko3hrweita-ats.iot.ap-south-1.amazonaws.com"
CONFIG_NAPHOME_AWS_IOT_PORT=8883
CONFIG_NAPHOME_AWS_IOT_KEEPALIVE_SEC=120
CONFIG_NAPHOME_AWS_IOT_CLEAN_SESSION=y
CONFIG_NAPHOME_AWS_IOT_AUTO_RECONNECT=y
CONFIG_NAPHOME_AWS_IOT_FAIL_ON_PLACEHOLDER_CERTS=n
CONFIG_SOMNUS_MQTT_CERT_DISCOVERY=y
CONFIG_SOMNUS_MQTT_CERT_DIR="/spiffs/Cert"

# Flash Configuration
CONFIG_ESPTOOLPY_FLASHSIZE_8MB=y
CONFIG_ESPTOOLPY_FLASHSIZE="8MB"
```
