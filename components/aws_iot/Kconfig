## components/aws_iot/Kconfig
```kconfig
menu "Naphome AWS IoT"

config NAPHOME_AWS_IOT_ENDPOINT
    string "AWS IoT endpoint"
    default ""
    help
        Fully qualified AWS IoT Core endpoint hostname. Example:
        "xxxxxxxxxx-ats.iot.us-west-2.amazonaws.com"

config NAPHOME_AWS_IOT_CLIENT_ID
    string "AWS IoT client ID / Thing name"
    default ""
    help
        Client identifier used when connecting to AWS IoT Core. Typically matches
        the Thing name provisioned for the device.

config NAPHOME_AWS_IOT_PORT
    int "AWS IoT MQTT port"
    default 8883
    help
        TLS port used for MQTT over mutual TLS. Default is 8883.

config NAPHOME_AWS_IOT_KEEPALIVE_SEC
    int "AWS IoT MQTT keepalive (seconds)"
    default 60
    range 10 1200
    help
        Keepalive interval requested by the device. AWS IoT enforces an upper
        bound of 1200 seconds.

config NAPHOME_AWS_IOT_CLEAN_SESSION
    bool "Start clean MQTT session"
    default y
    help
        When enabled, the client requests a clean session on connect.

config NAPHOME_AWS_IOT_AUTO_RECONNECT
    bool "Enable AWS IoT auto-reconnect"
    default y
    help
        When enabled, the AWS IoT SDK attempts to reconnect automatically after
        a disconnection.

config NAPHOME_AWS_IOT_FAIL_ON_PLACEHOLDER_CERTS
    bool "Abort init if placeholder credentials detected"
    default y
    help
        If enabled, the firmware refuses to initialise AWS IoT using the
        placeholder credentials shipped with the repository.

config NAPHOME_AWS_IOT_SUBSCRIBE_TOPIC
    string "Default subscription topic"
    default ""
    help
        Optional topic to subscribe to automatically once the MQTT connection
        succeeds. Leave empty to disable the automatic subscription.

config NAPHOME_AWS_IOT_SUBSCRIBE_QOS
    int "Default subscription QoS"
    default 0
    range 0 1
    help
        QoS level used when subscribing to the default topic (if provided).

config NAPHOME_AWS_IOT_YIELD_TIMEOUT_MS
    int "MQTT yield timeout (ms)"
    default 200
    range 10 1000
    help
        Timeout supplied to aws_iot_mqtt_yield while running the AWS IoT service
        loop.


endmenu
```

## components/cspot_component/Kconfig
```kconfig
menu "cspot Spotify Connect"

config CSPOT_ENABLE
    bool "Include cspot Spotify Connect support"
    default y
    help
        Enable integration of the cspot Spotify Connect library from
        CONFIG_CSPOT_PATH. Disable if you do not wish to build Spotify support.

config CSPOT_PATH
    string "Path to cspot checkout"
    depends on CSPOT_ENABLE
    default "~/GitHub/cspot"
    help
        Filesystem path to a local clone of https://github.com/cspot-developers/cspot.
        Must contain cspot/CMakeLists.txt.

endmenu
```

## components/matter_bridge/Kconfig
```kconfig
menu "Naphome Matter Bridge"

config NAPHOME_MATTER_BRIDGE_ENABLE
    bool "Enable Matter bridge for sensor telemetry"
    default n
    help
        When enabled the firmware exposes collected sensor telemetry via the
        Matter application layer so that controllers on the fabric can observe
        state changes through standard clusters.

config NAPHOME_MATTER_BRIDGE_MAX_SENSORS
    int "Maximum number of bridged sensors"
    depends on NAPHOME_MATTER_BRIDGE_ENABLE
    default 8
    range 1 32
    help
        Upper bound for the number of logical sensors that can be exported via
        the Matter bridge component.

config NAPHOME_MATTER_BRIDGE_SENSOR_NAME_MAX_LEN
    int "Maximum sensor name length"
    depends on NAPHOME_MATTER_BRIDGE_ENABLE
    default 32
    range 8 96
    help
        Sensor identifiers are copied into a static registry. Increase if your
        sensor names exceed the default limit.

config NAPHOME_MATTER_BRIDGE_ENDPOINT_LABEL_MAX_LEN
    int "Maximum endpoint label length"
    depends on NAPHOME_MATTER_BRIDGE_ENABLE
    default 32
    range 8 64
    help
        Friendly labels assigned to bridged endpoints are truncated to this
        length.

config NAPHOME_MATTER_BRIDGE_USE_ESPMATTER
    bool "Link against esp-matter and expose native Matter endpoints"
    depends on NAPHOME_MATTER_BRIDGE_ENABLE
    default n
    help
        Enable this option when building with the Espressif esp-matter
        component. When selected the bridge uses esp-matter APIs to create
        dynamic endpoints and update clusters. Leave disabled to build a stub
        bridge that logs state changes without interacting with the Matter
        stack (useful for bring-up and CI).

endmenu
```

## components/naptick_http/Kconfig
```kconfig
menu "Naptick HTTP Configuration"

    config NAPTICK_HTTP_REGISTRATION_URL
        string "Device registration API endpoint"
        default "https://api-uat.naptick.com/user/user-service/app-registration"
        help
            URL for the device registration endpoint.

    config NAPTICK_HTTP_SENSOR_UPLOAD_URL
        string "Sensor data upload API endpoint"
        default "https://api-uat.naptick.com/sensor-service/sensor-service/stream"
        help
            URL for the sensor data upload endpoint.

    config NAPTICK_HTTP_TIMEOUT_MS
        int "HTTP request timeout in milliseconds"
        default 30000
        help
            Timeout for HTTP requests.

endmenu
```

## components/naptick_mqtt/Kconfig
```kconfig
menu "Naptick MQTT Configuration"

    config NAPTICK_MQTT_BROKER_URI
        string "MQTT Broker URI"
        default "wss://api-uat.naptick.com:443/mqtt"
        help
            WebSocket Secure URI for the MQTT broker.

    config NAPTICK_MQTT_KEEPALIVE_SEC
        int "MQTT Keep-alive interval in seconds"
        default 120
        help
            Keep-alive interval for MQTT connection.

    config NAPTICK_MQTT_RECONNECT_TIMEOUT_MS
        int "MQTT Reconnect timeout in milliseconds"
        default 5000
        help
            Time to wait before attempting to reconnect.

endmenu
```

## components/naptick_uart/Kconfig
```kconfig
menu "Naptick UART Configuration"

    config NAPTICK_UART_PORT_NUM
        int "UART port number"
        default 1
        range 0 2
        help
            UART port number for sensor data.

    config NAPTICK_UART_BAUD_RATE
        int "UART baud rate"
        default 9600
        help
            Baud rate for UART communication.

    config NAPTICK_UART_TX_PIN
        int "UART TX GPIO pin"
        default 17
        help
            GPIO pin for UART TX.

    config NAPTICK_UART_RX_PIN
        int "UART RX GPIO pin"
        default 18
        help
            GPIO pin for UART RX.

    config NAPTICK_UART_RX_BUF_SIZE
        int "UART RX buffer size"
        default 2048
        help
            Size of UART receive buffer.

    config NAPTICK_UART_TASK_STACK
        int "UART task stack size"
        default 4096
        help
            Stack size for UART receive task.

endmenu
```

## components/openwakeword/Kconfig.projbuild
```kconfig
menu "OpenWakeWord Configuration"

    config OPENWAKEWORD_ENABLE
        bool "Enable OpenWakeWord wake word detection"
        default n
        help
            Enable OpenWakeWord for self-trained wake word detection.
            Requires TensorFlow Lite Micro and trained model.

    config OPENWAKEWORD_USE_TFLITE
        bool "Use TensorFlow Lite Micro for inference"
        default n
        depends on OPENWAKEWORD_ENABLE
        help
            Enable TensorFlow Lite Micro integration for model inference.
            Requires esp-tflite-micro component to be added.

    config OPENWAKEWORD_MODEL_PATH
        string "Wake word model path"
        default "/spiffs/hey_naptick.tflite"
        depends on OPENWAKEWORD_ENABLE
        help
            Path to TFLite model file in SPIFFS or partition.

    config OPENWAKEWORD_THRESHOLD
        int "Detection threshold (0 to 1000, represents 0.0 to 1.0)"
        range 0 1000
        default 500
        depends on OPENWAKEWORD_ENABLE
        help
            Confidence threshold for wake word detection (0-1000 = 0.0-1.0).
            Higher values = fewer false positives, more false negatives.

    config OPENWAKEWORD_FRAME_SIZE_MS
        int "Audio frame size (milliseconds)"
        range 10 200
        default 80
        depends on OPENWAKEWORD_ENABLE
        help
            Audio frame size for processing. OpenWakeWord uses 80ms frames.
            Smaller = lower latency but more CPU usage.

    config OPENWAKEWORD_COOLDOWN_MS
        int "Detection cooldown (milliseconds)"
        range 0 10000
        default 2000
        depends on OPENWAKEWORD_ENABLE
        help
            Minimum time between detections to avoid repeated triggers.

    config OPENWAKEWORD_TENSOR_ARENA_SIZE
        int "TensorFlow Lite tensor arena size (bytes)"
        default 16384
        range 4096 131072
        depends on OPENWAKEWORD_USE_TFLITE
        help
            Memory arena size for TFLite interpreter.
            Larger models may need more memory.
            Typical: 8-32 KB for small wake word models.

endmenu
```

## components/sensor_manager/Kconfig
```kconfig
menu "Sensor Manager"

config SENSOR_MANAGER_PUBLISH_INTERVAL_MS
    int "Sensor telemetry publish interval (ms)"
    default 10000
    range 1000 600000
    help
        Interval at which the sensor manager aggregates registered sensor readings
        and publishes a telemetry payload via MQTT.

endmenu
```

## components/somnus_mqtt/Kconfig
```kconfig
menu "Somnus MQTT Integration"

config SOMNUS_MQTT_CERT_DISCOVERY
    bool "Enable runtime discovery of Somnus certificate bundle"
    default y
    help
        When enabled, the firmware scans a certificate directory at runtime to
        locate the Somnus TLS credentials (certificate, private key, and CA).
        Disable to rely solely on the embedded PEM files packaged with the
        firmware build.

config SOMNUS_MQTT_CERT_DIR
    string "Somnus certificate directory"
    depends on SOMNUS_MQTT_CERT_DISCOVERY
    default "/spiffs/Cert"
    help
        Filesystem path scanned for certificate bundles. The directory should
        contain files named following the Somnus convention:
          <prefix>-certificate.pem.crt
          <prefix>-private.pem.key
          AmazonRootCA1.pem (or *CA1.pem)

config SOMNUS_MQTT_SUBSCRIBE_QOS
    int "Somnus subscribe QoS"
    default 1
    range 0 1
    help
        QoS level used when subscribing to the Somnus command topic.

endmenu
```

## components/wifi_manager/Kconfig
```kconfig
menu "Naphome Wi-Fi Manager"

config NAPHOME_WIFI_SSID
    string "Wi-Fi SSID"
    default ""
    help
        SSID of the Wi-Fi network to join in station mode.

config NAPHOME_WIFI_PASSWORD
    string "Wi-Fi password"
    default ""
    help
        Passphrase for the Wi-Fi network. Leave empty for open networks.

config NAPHOME_WIFI_MAX_RETRY
    int "Maximum reconnect attempts (0 = infinite)"
    default 0
    range 0 100
    help
        Number of times the Wi-Fi manager retries the connection before giving
        up. Set to 0 to keep retrying indefinitely.

endmenu
```

## config/sdkconfig.defaults
```kconfig
# Naphome Phase 0.9 Firmware Configuration Defaults

# Target chip
CONFIG_IDF_TARGET="esp32s3"

# Component config
CONFIG_ESP_MAIN_TASK_STACK_SIZE=8192
CONFIG_ESP_TASK_WDT_TIMEOUT_S=10

# I2C Configuration
CONFIG_I2C_ENABLE_DEBUG_LOG=n

# WiFi Configuration
CONFIG_ESP32_WIFI_STATIC_RX_BUFFER_NUM=10
CONFIG_ESP32_WIFI_DYNAMIC_RX_BUFFER_NUM=32

# FreeRTOS
CONFIG_FREERTOS_HZ=1000

# Logging
CONFIG_LOG_DEFAULT_LEVEL_INFO=y
CONFIG_LOG_MAXIMUM_LEVEL_VERBOSE=y

# Sensor Manager - Publish sensor data every 2 seconds for app monitoring
CONFIG_SENSOR_MANAGER_PUBLISH_INTERVAL_MS=2000
```

## samples/atom_echo_rules_demo/main/Kconfig.projbuild
```kconfig
menu "Atom Echo Rules Demo"

config ATOM_ECHO_LCD_SCLK_GPIO
    int "LCD SCLK GPIO"
    default 15

config ATOM_ECHO_LCD_MOSI_GPIO
    int "LCD MOSI GPIO"
    default 21

config ATOM_ECHO_LCD_CS_GPIO
    int "LCD CS GPIO"
    default 14

config ATOM_ECHO_LCD_DC_GPIO
    int "LCD DC GPIO (DISP_RS)"
    default 48

config ATOM_ECHO_LCD_RST_GPIO
    int "LCD reset GPIO (DISP_RST)"
    default 42

config ATOM_ECHO_LCD_BL_GPIO
    int "LCD backlight GPIO"
    default 0

config ATOM_ECHO_LCD_MAX_TRANSFER
    int "LCD max transfer bytes"
    default 0

config ATOM_ECHO_NEOPIXEL_GPIO
    int "WS2812 data GPIO"
    default -1

config ATOM_ECHO_NEOPIXEL_COUNT
    int "WS2812 pixel count"
    default 0

config ATOM_ECHO_NEOPIXEL_BRIGHTNESS
    int "WS2812 master brightness (0-255)"
    range 1 255
    default 48

config ATOM_ECHO_I2C_SCAN_FREQ_HZ
    int "I2C scan frequency (Hz)"
    default 100000

config ATOM_ECHO_I2C_INTERNAL_SDA
    int "Internal IMU bus SDA GPIO"
    default 38

config ATOM_ECHO_I2C_INTERNAL_SCL
    int "Internal IMU bus SCL GPIO"
    default 39

config ATOM_ECHO_I2C_INTERNAL_PORT
    int "Internal IMU bus controller"
    range 0 1
    default 0

config ATOM_ECHO_I2C_ATOM_SDA
    int "Atom header SDA GPIO"
    default 38

config ATOM_ECHO_I2C_ATOM_SCL
    int "Atom header SCL GPIO"
    default 39

config ATOM_ECHO_I2C_ATOM_PORT
    int "Atom header bus controller"
    range 0 1
    default 0

config ATOM_ECHO_I2C_PORTA_SDA
    int "Port A SDA GPIO"
    default 2

config ATOM_ECHO_I2C_PORTA_SCL
    int "Port A SCL GPIO"
    default 1

config ATOM_ECHO_I2C_PORTA_PORT
    int "Port A bus controller"
    range 0 1
    default 1

config ATOM_ECHO_AUDIO_ENABLED
    bool "Enable audio playback (ES8388 codec)"
    default y
    help
        Enable audio player for M5Stack Audio Module ES8388

config ATOM_ECHO_AUDIO_I2C_SDA
    int "Audio codec I2C SDA GPIO"
    default 38
    depends on ATOM_ECHO_AUDIO_ENABLED
    help
        I2C SDA pin for codec (Internal I2C bus - SYS_SDA)

config ATOM_ECHO_AUDIO_I2C_SCL
    int "Audio codec I2C SCL GPIO"
    default 39
    depends on ATOM_ECHO_AUDIO_ENABLED
    help
        I2C SCL pin for codec (Internal I2C bus - SYS_SCL)

config ATOM_ECHO_AUDIO_I2S_BCLK
    int "Audio codec I2S BCLK GPIO"
    default 8
    depends on ATOM_ECHO_AUDIO_ENABLED
    help
        I2S bit clock pin (BCLK) - Atom S3R Echo Base GPIO8 (per M5Stack config)

config ATOM_ECHO_AUDIO_I2S_LRCLK
    int "Audio codec I2S LRCLK GPIO"
    default 6
    depends on ATOM_ECHO_AUDIO_ENABLED
    help
        I2S word select (LRCK) - Atom S3R Echo Base GPIO6 (per M5Stack config)

config ATOM_ECHO_AUDIO_I2S_DATA
    int "Audio codec I2S DATA GPIO"
    default 5
    depends on ATOM_ECHO_AUDIO_ENABLED
    help
        I2S data output (DOUT) - Atom S3R Echo Base GPIO5 (per M5Stack config)

config ATOM_ECHO_AUDIO_I2S_MCLK
    int "Audio codec I2S MCLK GPIO"
    default -1
    depends on ATOM_ECHO_AUDIO_ENABLED
    help
        I2S master clock (MCLK) - Atom S3R Echo Base uses -1 (not used, per M5Stack config)

config ATOM_ECHO_AUDIO_SAMPLE_RATE
    int "Audio sample rate (Hz)"
    default 16000
    range 8000 48000
    depends on ATOM_ECHO_AUDIO_ENABLED
    help
        Default sample rate for audio playback - Echo Base uses 16000 Hz (per M5Stack config)

config OTA_GITHUB_TOKEN
    string "GitHub Personal Access Token for OTA updates"
    default ""
    help
        GitHub Personal Access Token (PAT) for accessing GitHub API during OTA updates.
        Leave empty to use GITHUB_TOKEN environment variable or disable authenticated requests.
        WARNING: Never commit tokens to version control. Use sdkconfig.local or environment variables.

endmenu
```
